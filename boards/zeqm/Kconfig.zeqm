## boards/zeqm/Kconfig.zeqm
```kconfig
# Zephyr EQM Board Configuration File

# Copyright (c) 2025, Paulo Santos (wkhadgar@github)
# SPDX-License-Identifier: Apache-2.0

config BOARD_ZEQM
	select SOC_STM32F103X8
```

## boards/zeqm/board.yml
```yaml
board:
  name: zeqm
  full_name: Zephyr Equatorial Mount Board
  vendor: wkhadgar
  revision:
    format: custom
    default: "dev"
    revisions:
      - name: "dev"
  socs:
    - name: stm32f103xb
```
